//Mod by STE & Boogs 2025-03-29

#define MODE 2   // pin A0 of PCB
#define CSW 3    // pin 14 of TMS9918A
#define CSR 8    // pin 15 of TMS9918A
#define RESET 9  // pin RST of PCB 
     
#define PORT_MANIPULATION

unsigned char font[] = {
// line drawing
   0x00,0x00,0x00,0xFF,0xFF,0x00,0x00,0x00, // lr
   0x18,0x18,0x18,0x18,0x18,0x18,0x18,0x18, // ud
   0x00,0x00,0x00,0xF8,0xF8,0x18,0x18,0x18, // ld
   0x00,0x00,0x00,0x1F,0x1F,0x18,0x18,0x18, // rd
   0x18,0x18,0x18,0xF8,0xF8,0x00,0x00,0x00, // lu
   0x18,0x18,0x18,0x1F,0x1F,0x00,0x00,0x00, // ur
   0x18,0x18,0x18,0xFF,0xFF,0x18,0x18,0x18, // lurd
// <nonsense for debug>
   0x07,0x07,0x07,0x07,0x07,0x07,0x07,0x00, // 07
   0x08,0x08,0x08,0x08,0x08,0x08,0x08,0x00, // 08
   0x09,0x09,0x09,0x09,0x09,0x09,0x09,0x00, // 09
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   0x1F,0x1F,0x1F,0x1F,0x1F,0x1F,0x1F,0x00, // 1F
// </nonsense>
   0x00,0x00,0x00,0x00,0x00,0x00,0x00,0x00, // ' '
   0x20,0x20,0x20,0x20,0x20,0x00,0x20,0x00, // !
   0x50,0x50,0x50,0x00,0x00,0x00,0x00,0x00, // "
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   0xA8,0x50,0xA8,0x50,0xA8,0x50,0xA8,0x00, // checkerboard

  };


void setDBReadMode() {
  DDRD = DDRD & B00001111; // Set Pin 4 5 6 7 as inputs. High nibble of databus.
  DDRC = DDRC & B11110000; // Set Analog pin A0 A1 A2 A3 as inputs. Low nibble of databus.      
}

void setDBWriteMode() {
  DDRD = DDRD | B11110000; // Set Pin 4 5 6 7 as outputs. High nibble of databus.p
  DDRC = DDRC | B00001111; // Set Analog pin A0 A1 A2 A3 as outputs. Low nibble of databus.
}

void reset() {
  Serial.println("Resetting");
  digitalWrite(RESET, HIGH);
  delayMicroseconds(100);
  digitalWrite(RESET, LOW);
  delayMicroseconds(5);  
  digitalWrite(RESET, HIGH);
}

inline void setPort(unsigned char value) {   
    PORTD = (PIND & 0x0F) | (value & 0xF0);    // Starting from value (1 char, 8 bits) write right bit
    PORTC = (PINC & 0xF0) | (value & 0x0F);    // in right position
}

inline unsigned char readPort() {
    unsigned char memByte = 0;                 // Generating memByte (1 char, 8 bits) accordingly 
    memByte  = (PIND & 0xF0) | (PINC & 0x0F);  // with data read
    return memByte;
}

void writeByte( unsigned char value) {         // Writes a byte to databus for register access
    setDBWriteMode();                          // All outputs
    setPort(value);                            // Write data
    digitalWrite(MODE, HIGH);        
    digitalWrite(CSW, LOW);            
    delayMicroseconds(10);
    digitalWrite(CSW, HIGH);
    setDBReadMode();                           // All inputs
}

unsigned char  readByte( ) {                   // Reads a byte from databus for register access
    unsigned char memByte = 0;
    digitalWrite(MODE, HIGH);            
    digitalWrite(CSR, LOW);        
    delayMicroseconds(10);
    memByte = readPort();                      // Read data
    digitalWrite(CSR, HIGH);
    return memByte;
}

void writeByteToVRAM( unsigned char value) {   //Writes a byte to databus for vram access Byte 3 for "WRITE TO VRAM" 
    digitalWrite(MODE, LOW);                   
    digitalWrite(CSW, LOW);            
    setDBWriteMode();                          // All outputs  
    setPort(value);                            // Write data
    delayMicroseconds(10);
    digitalWrite(CSW, HIGH);
    setDBReadMode();                           // All inputs
    delayMicroseconds(10);      
}
unsigned char  readByteFromVRAM( ) {           //Reads a byte from databus for vram access Byte 3 for "READ FROM VRAM"
    unsigned char memByte = 0;
    digitalWrite(MODE, LOW);            
    digitalWrite(CSR, LOW);        
    delayMicroseconds(1);
    memByte = readPort();                      // read data
    digitalWrite(CSR, HIGH);
    delayMicroseconds(10);    
    return memByte;
}

void setRegister(unsigned char registerIndex, unsigned char value) { // "WRITE TO VDP REGISTER"
  writeByte(value);                                                  // byte 1 DATA WRITE
  writeByte(0x80 | registerIndex);                                   // byte 2 REGISTER SELECT merge 10000XXX
}

void setWriteAddress( unsigned int address) {                        // "WRITE TO VRAM"  
  writeByte(address & 0xFF);                                         // byte 1 ADDRESS SETUP (A6..A13)
  writeByte(0x40 | ((address >> 8) & 0x3F));                         // byte 2 ADDRESS SETUP (0 1 A0..A5)
}

void setReadAddress( unsigned int address) {                         // "READ FROM VRAM"
  writeByte((address & 0xFFC0)>>6);                                  // byte 1 ADDRESS SETUP (A6..A13)
  writeByte((address & 0x3F));                                       // byte 2 ADDRESS SETUP (0 0 A0..A5)
}

void setCursor(unsigned char x, unsigned char y) {
  setWriteAddress(0x800 + 40*y + x);
}

void writeString(String str) {
  for(int i = 0; i < str.length(); i++)
    writeByteToVRAM(str.charAt(i));
}


void setup() {
  setDBReadMode();
  Serial.begin(9600);
  pinMode(MODE, OUTPUT);
  pinMode(RESET, OUTPUT);
  pinMode(CSW, OUTPUT);
  pinMode(CSR, OUTPUT);  
  
  digitalWrite(RESET, HIGH);      // All not active                                 
  digitalWrite(MODE, HIGH);  
  digitalWrite(CSW, HIGH);    
  digitalWrite(CSR, HIGH);  
  
  reset();
  delay(200);

  setRegister(0, 0x00);   // Register 0: 0 0 0 0 0 0 0 M3 ( M3 = 0 ) Mode TEXT M1,M2,M3 = 1 0 0
  setRegister(1, 0xD0);   // Register 1: 1 1 0 1 0 0 0 0 ( 16K, Screen Enable, Interrupt Disable )
                          // Example table 6.1
  setRegister(2, 0x02);   //Name table              0X02 --> $0800
  setRegister(3, 0x00);   //Color table             NOT USED 
  setRegister(4, 0x00);   //Pattern table           0x00 --> $0000   
  setRegister(5, 0x20);   //Sprite attribute table  NOT USED   
  setRegister(6, 0x00);   //Sprite pattern table    NOT USED     
  setRegister(7, 0xFD);   //Font & Background color (WHITE & LIGHT BLUE ) 
  
  Serial.println("Clearing RAM"); //Max Ram 16Kbyte
  setWriteAddress(0);
  for (int i = 0;i<16384;i++) {
    writeByteToVRAM(0);
  } 

  unsigned int nameTableStart    = 0x0002 * 0x400;
  unsigned int patternTableStart = 0x0000 * 0x800;
  
    // Pattern Table
    setWriteAddress(patternTableStart); 
    for(int i = 0; i < 256*8; i++) {
      writeByteToVRAM(font[i]);
    }

    setWriteAddress(0x800);
    for(int i = 0; i < 960; i++) writeByteToVRAM(' ');

}

signed char x = 0;
signed char y = 0;
signed char xinc = 1;
signed char yinc = 1;

String str = "Hello, World!";
String clr = "             ";
unsigned char len = str.length();

void loop() { 
    setCursor(x,y);
    writeString(str);
    delay(100);
    setCursor(x,y);
    writeString(clr);
    y+=yinc;
    if(y > 23) {
      yinc = -1;
      y = 22;
    } else if(y < 0) {
      yinc = 1;
      y = 1;
    }

    x+=xinc;
    if(x + len >= 40) {
      xinc = -1;
      x = 40 - len;
    } else if(x < 0) {
      xinc = 1;
      x = 0;
    }

    
}  




